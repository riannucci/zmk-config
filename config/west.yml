## config/west.yml
```yaml
manifest:
  remotes:
    - name: zmkfirmware
      url-base: https://github.com/zmkfirmware
    - name: ethan605
      url-base: https://github.com/ethan605
  projects:
    - name: zmk
      remote: zmkfirmware
      revision: edf5c0814fd3ea202e43aad2d68fd32e882a518c   # v0.3.0
      import: app/west.yml       # Pulls in Zephyr and all ZMK dependencies
    - name: zmk-dongle-screen
      remote: ethan605
      revision: 26833cbca25b4cc76de4559149dc96a78bfd3b6b   # feat(corne-custom)
  self:
    path: config
```

## dts/bindings/behaviors/zmk,behavior-ecaps-word.yaml
```yaml
# Copyright (c) 2021 The ZMK Contributors
# SPDX-License-Identifier: MIT
#
# Derived from zmk,behavior-caps-word.yaml. Adds `shift-list`.

description: Extended caps word behavior (caps_word plus a shift-list and unshift-list)

compatible: "zmk,behavior-ecaps-word"

include: zero_param.yaml

properties:
  continue-list:
    type: array
    required: true
  shift-list:
    type: array
  unshift-list:
    type: array
  mods:
    type: int
```

## modules/ecaps-word/Kconfig
```kconfig
config ZMK_BEHAVIOR_ECAPS_WORD
    bool "Extended caps-word behavior (caps_word + shift-list)"
    default y
    depends on DT_HAS_ZMK_BEHAVIOR_ECAPS_WORD_ENABLED
    depends on !ZMK_SPLIT || ZMK_SPLIT_ROLE_CENTRAL
```
